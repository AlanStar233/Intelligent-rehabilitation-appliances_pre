#include <ioCC2530.h>
#include "type.h"
#include "clock.h"
#include "lcd.h"

//-------------  ASCII字符库----------------------------------------------------------------
//说明：该字库为5*7点阵字符字模库，但字库格式为8*8点阵字模数据，第8行为行间距，
//      第6-8列为字间距。可以使用6*8点阵、7*8点阵、8*8点阵形式的字符显示
__code const INT8U ASCIITAB[]=
{
  0x00,0x00,0x00,0x00,0x00,0x00,0x00,0x00,    /*" "=00H*/
  0x00,0x00,0x00,0x4F,0x00,0x00,0x00,0x00,    /*"!"=01H*/
  0x00,0x00,0x07,0x00,0x07,0x00,0x00,0x00,    /*"""=02h*/
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  0x00,0xFF,0xFF,0xFF,0xFF,0xFF,0x00,0x00     /*" "=0x60*/
};
         
void lcd_delay_us(unsigned int s)
{
  uint16 i;
  for(i=0; i<s; i++);
    for(i=0; i<s; i++);
}

void lcd_delay_ms(unsigned int s)
{
  uint16 i;
  for(i=0; i<s; i++);
    lcd_delay_us(10000);
}

void SendCmd(uchar Command)
{
  uchar j, bit7;
  
  L_CK = 1;
  L_LD = 0;
  L_CS = 0;
  for (j = 0; j < 8; j++)
  {
    bit7 = Command & 0x80;
    if (bit7 == 0)
    {
            L_DA = 0;
    }
    else
    {
            L_DA = 1;
    }

    L_CK = 0;
    L_CK = 1;
    Command = Command << 1;
  }
  
  L_CS = 1;
}

void SendData(uchar DDate)
{
  uchar j, bit7;
  
  L_CK = 1;
  L_LD = 1;
  L_CS = 0;
  
  for (j = 0; j < 8; j++)
  {
    bit7 = DDate & 0x80;
    if (bit7 == 0)
    {
            L_DA = 0;
    }
    else
    {
            L_DA = 1;
    }

    L_CK = 0;
    L_CK = 1;
    DDate = DDate << 1;
  }
  
  L_CS = 1;
}

static void lcdIOInit( void )
{
  P0DIR |= (0X01|0x80);      //P00 RS
  P1DIR |= (0x04|0x40|0x20);    //P12 P15 P16
}

static void ResetLCD(void)
{
  L_BK = 1;
  lcd_delay_ms(500);
}

static void initLCDM(void)
{
  uchar ContrastLevel;    //定义对比度
  ContrastLevel = 0xa0;   //对比度，根据不同的LCD调节，否则无法显示。
  SendCmd(0xaf);          //开显示
  SendCmd(0x40);          //显示起始行为0
  SendCmd(0xa0);          //RAM列地址与列驱动同顺序
  SendCmd(0xa6);          //正向显示
  SendCmd(0xa4);          //显示全亮功能关闭
  SendCmd(0xa2);          //LCD偏压比1/9
  SendCmd(0xc8);          //行驱动方向为反向
  SendCmd(0x2f);          //启用内部LCD驱动电源
  SendCmd(0xf8);          //升压电路设置指令代码
  SendCmd(0x00);          //倍压设置为4X
  SendCmd(ContrastLevel); //设置对比度
}

void ClearRAM(void)
{
  uint8 i,j;
  for (i = 0; i < 8; i++)
  {
    SendCmd(i|0xb0);
    SendCmd(0x10);
    SendCmd(0x00);
    for (j = 0; j < 132; j++)
    {
      SendData(0);
    }
  }
}

void lcdInit( void )
{
  lcdIOInit();
  ResetLCD(); //复位LCD 
  initLCDM(); //初始化LCD
  ClearRAM(); //请液晶缓存  
  
  lcd_delay_us(100); 
}

void lcdPrintString(uint8 x, uint8 y, uchar *pstr)
{
  uchar j;
  uint16 addr;
  SendCmd(y|0xb0);
  SendCmd((x >> 4)|0x10); //x是用10和00 的低4位
  SendCmd(x&0x0f);
  
  while (*pstr > 0)
  {
    addr = *pstr++;
    addr = (addr - 0x20)*8;//ASCII字符库从第32个开始
    for (j = 0; j < 6; j++)
    {
      SendData(ASCIITAB[addr+j]);
    }
  }
}

void lcdPrintUint8(uint8 x, uint8 y, uint8 data)
{
  uchar *pstr = "012";
  pstr[0] = data/100+'0';
  pstr[1] = data%100/10+'0';
  pstr[2] = data%10+'0';
  lcdPrintString(x,y,pstr);
}